#include "Screen.h"
#include "Adafruit_ILI9341.h"
#include <Fonts/FreeSans9pt7b.h>

#define SLine1 10 // these are for graphics use
#define SLine2 50 // they define the line starts in pixels
#define SLine3 120
#define SLine4 210
#define SCol1 20

#define LLine1 80
#define LLine2 140
#define LCol1 20
#define LCol2 190

#define ARC_BLUE 0x21F2
#define ARC_GREEN 0xA668

#define Ver "v1.6"
#define Ver_Date "July 23, 2019"

static const uint8_t PROGMEM arcLogo[] = {
  0x00, 0x00, 0x00, 0x00, 0x00, 0x00, 0x00, 0x00, 0x00, 0x00, 0x00, 0x00,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 0x00
};

Screen::Screen(int8_t csPin, int8_t dcPin):
  _tft(csPin, dcPin) {
  _tft.begin();
  _tft.fillScreen(ILI9341_BLACK);
  _tft.setFont(&FreeSans9pt7b);
}

void Screen::Print(int x, int y, const char* value, int color) {
  _tft.setTextColor(color);
  _tft.setCursor(x, y);
  _tft.print(value);
  if (color != ILI9341_BLACK) { _tft.setTextColor(ILI9341_BLACK); }
}

void Screen::Print(int x, int y, String value, int color) {
  _tft.setTextColor(color);
  _tft.setCursor(x, y);
  _tft.print(value);
  if (color != ILI9341_BLACK) { _tft.setTextColor(ILI9341_BLACK); }
}

void Screen::Print(int x, int y, int value, int color) {
  _tft.setTextColor(color);
  _tft.setCursor(x, y);
  _tft.print(value);
  if (color != ILI9341_BLACK) { _tft.setTextColor(ILI9341_BLACK); }
}

void Screen::Print(int x, int y, double value, int decimalPlaces, int color) {
  _tft.setTextColor(color);
  _tft.setCursor(x, y);
  _tft.print(value, decimalPlaces);
  if (color != ILI9341_BLACK) { _tft.setTextColor(ILI9341_BLACK); }
}

void Screen::UpdateSetpointLocation(int x, int y) {
  setpointLocationXY[0] = x;
  setpointLocationXY[1] = y;
}

void Screen::Test() {
  _tft.begin();
  
  PrintTftDataToSerial();
  
  Serial.println(F("Benchmark                Time (microseconds)"));
  delay(10);
  Serial.print(F("Screen fill              "));
  Serial.println(testFillScreen());

  Serial.print(F("Text                     "));
  
  for(uint8_t rotation=0; rotation<4; rotation++) {
    _tft.setRotation(rotation);
    Serial.println(testText());
  }

  Serial.print(F("Lines                    "));
  Serial.println(testLines(ILI9341_CYAN));

  Serial.print(F("Rectangles (filled)      "));
  Serial.println(testFilledRects(ILI9341_YELLOW, ILI9341_MAGENTA));

  Serial.print(F("Triangles (outline)      "));
  Serial.println(testTriangles());

  Serial.print(F("Triangles (filled)       "));
  Serial.println(testFilledTriangles());

  Serial.print(F("Rounded rects (outline)  "));
  Serial.println(testRoundRects());

  Serial.print(F("Rounded rects (filled)   "));
  Serial.println(testFilledRoundRects());

  Serial.println(F("Done!"));

  _tft.setRotation(1);
  _tft.fillScreen(ILI9341_BLACK);
  _tft.setCursor(0, 0);
  _tft.setTextColor(ILI9341_WHITE); 
  _tft.setTextSize(3);
}

void Screen::TurnOff() {
  _tft.fillScreen(ILI9341_BLACK);
}

void Screen::ShowSetpointMenu(double setpoint) {
  _tft.fillScreen(ILI9341_WHITE);
  _tft.setTextColor(ILI9341_BLACK );
  _tft.setTextSize(2);
  DrawUpArrow(ILI9341_BLACK);
  DrawDownArrow(ILI9341_BLACK);
  Print(225, 210, "OK");
  Print(20, 50, "Setpoint:");
  UpdateSetpointLocation(180, 50);
  Print(180, 50, setpoint, 0);
}

void Screen::ShowDiagnostics(double current, double volts, double power, double resistance, double kp, double ki, double kd) {
  _tft.setTextSize(1);
  _tft.fillScreen(ILI9341_WHITE);
  
  Print(20,30, "Curr = ");
  _tft.setCursor(150, 30);
  _tft.print(current,0);   
  _tft.println(" mA");

  Print(20, 60, "Volts = ");
  _tft.setCursor(150,60);
  _tft.print(volts);
  _tft.println(" Volts");

  Print(20, 90, "Power = ");
  _tft.setCursor(150,90);
  _tft.print(power);
  _tft.println(" Watts");

  Print(20, 120, "Resistance = ");
  _tft.setCursor(150,120);
  _tft.print(resistance);
  _tft.println(" Ohms");

  Print(20, 150, "PID = ");
  _tft.setCursor(150,150);
  _tft.print(kp, 0);
  _tft.print(" - ");
  _tft.print(ki, 0);
  _tft.print(" - ");
  _tft.print(kd, 0);
  _tft.print(" ");

  _tft.setTextSize(2);

  Print(45, 200, "Press Any Key");
  Print(70, 235, "To Exit");
}

void Screen::ShowMain(double setpoint, double temperature) {

  _tft.fillScreen(ILI9341_WHITE);
  _tft.setTextSize(2);

  if(setpoint > 0) {
    Resume();
  } else {
    Pause();
  }
  
  Print(20, 40, "Setpoint");
  UpdateSetpointLocation(180, 40);
  UpdateSetpoint(0, setpoint);
  Print(285, 40, "C");
  _tft.drawCircle(280, 20, 3, ILI9341_BLACK);
  
  Print(20, 95, "Actual");
  UpdateTemperature(0, temperature);
  Print(285, 95, "C");
  _tft.drawCircle(280, 75, 3, ILI9341_BLACK);

  Print(20, 150, "Output");
  _tft.drawRect(184, 144, 15, 8, ILI9341_BLACK);
  _tft.drawRect(211, 136, 15, 16, ILI9341_BLACK);
  _tft.drawRect(238, 128, 15, 24, ILI9341_BLACK);
  _tft.drawRect(265, 120, 15, 32, ILI9341_BLACK);
  _tft.drawRect(292, 112, 15, 40, ILI9341_BLACK);

  DrawUpArrow(ILI9341_RED);
  DrawDownArrow(ILI9341_BLUE);
}

void Screen::DrawDownArrow(int color) {
  _tft.drawFastVLine(160, 190, 30, color);
  _tft.drawFastVLine(161, 190, 30, color);
  _tft.drawFastVLine(162, 190, 30, color);
  _tft.drawFastVLine(163, 190, 30, color);
  _tft.drawFastVLine(164, 190, 30, color);
  _tft.fillTriangle(162, 230, 150, 210, 174, 210, color);
}

void Screen::DrawUpArrow(int color) {
  _tft.drawFastVLine(70, 200, 30, color);
  _tft.drawFastVLine(71, 200, 30, color);
  _tft.drawFastVLine(72, 200, 30, color);
  _tft.drawFastVLine(73, 200, 30, color);
  _tft.drawFastVLine(74, 200, 30, color);
  _tft.fillTriangle(72, 190, 60, 210, 84, 210, color);
}

void Screen::DrawNumberedMenu(const char* header, const char* buttonOne, const char* buttonTwo, const char* buttonThree) {
  _tft.fillScreen(ILI9341_WHITE);
  _tft.setRotation(1);
  _tft.setTextSize(2);

  Print(SCol1, SLine2-10, header);
  
  if (buttonOne != NULL) {
    Print(SCol1, SLine2+40, "1 = ");
    Print(SCol1+65, SLine2+40, buttonOne);
    Print(SCol1+37, SLine4+15, "1");
  }
  if (buttonTwo != NULL) {
    Print(SCol1, SLine2+75, "2 = ");
    Print(SCol1+65, SLine2+75, buttonTwo);
    Print(SCol1+129, SLine4+15, "2");
  }
  if (buttonThree != NULL) {
    Print(SCol1, SLine2+110, "3 = ");
    Print(SCol1+65, SLine2+110, buttonThree);
    Print(SCol1+223, SLine4+15, "3");
  }
}

void Screen::PrintTftDataToSerial() {
  Serial.println();
  Serial.println("*** TFT Test ***");
  // read diagnostics (optional but can help debug problems)
  uint8_t x = _tft.readcommand8(ILI9341_RDMODE);
  Serial.print("Display Power Mode: 0x");
  Serial.println(x, HEX);
  x = _tft.readcommand8(ILI9341_RDMADCTL);
  Serial.print("MADCTL Mode: 0x");
  Serial.println(x, HEX);
  x = _tft.readcommand8(ILI9341_RDPIXFMT);
  Serial.print("Pixel Format: 0x");
  Serial.println(x, HEX);
  x = _tft.readcommand8(ILI9341_RDIMGFMT);
  Serial.print("Image Format: 0x");
  Serial.println(x, HEX);
  x = _tft.readcommand8(ILI9341_RDSELFDIAG);
  Serial.print("Self Diagnostic: 0x");
  Serial.println(x, HEX);
}

void Screen::ShowPolyarcNotFound() {
  _tft.fillScreen(ILI9341_WHITE);
  _tft.setCursor(00, 50);
  _tft.println("  Polyarc Not Found");
  _tft.println("  Check All");
  _tft.println("  Connections");
  _tft.println("  Then Press Any");
  _tft.print  ("  Key to Continue");
}

void Screen::ShowScreenTestMenu() {
  DrawNumberedMenu("Display Test", "Run", "Exit", NULL);
}

void Screen::ShowHeaterTestMenu() {
  DrawNumberedMenu("Heater Test", "Run", "Exit", NULL);
}

void Screen::ShowHeaterTestDriveResults(int drive, double temperature, double volts, double current, double power, double resistance) {
  _tft.fillScreen(ILI9341_WHITE);
  _tft.setTextSize(1);
  _tft.setCursor(0, 0);
  _tft.println();
  _tft.print("  Results D = ");
  _tft.println(drive);
  _tft.print("  RTD   = ");
  _tft.print(temperature, 0);
  _tft.println(" Deg");
  _tft.print("  Volts = ");
  _tft.print(volts, 1);
  _tft.println(" V");
  _tft.print("  Curr  = ");
  _tft.print(current, 0); //
  _tft.println(" mA");
  _tft.print("  Power = ");
  _tft.print(power,1);
  _tft.println(" W");
  _tft.print("  Htr R = ");
  _tft.println(resistance, 0);
  _tft.setTextSize(2);
  Print(SCol1, SLine4, " Inc   Dec  Exit ");   
}

void Screen::ShowHeaterTestDriveHeader(int drive) {
  _tft.fillScreen(ILI9341_WHITE);
  _tft.setRotation(1);
  _tft.setCursor(0, 0);
  _tft.println();
  _tft.println("  *** Testing ***");
  _tft.print  ("     Drive = ");
  _tft.println(drive);
}

void Screen::ShowWatchdogTestMenu() {
  DrawNumberedMenu("Watch Dog Test", "Run", "Exit", NULL);
}

void Screen::ShowAliTestMenu() {
  DrawNumberedMenu("ALI Tests", "Heater", "Display", "More");
}

void Screen::ShowMoreAliTestMenu() {
  DrawNumberedMenu("ALI Tests", "Watch Dog", "Back", "Exit");
}

void Screen::ShowTestingHeader() {
  _tft.fillScreen(ILI9341_WHITE);
  _tft.setTextSize(2);
  Print(20, 50, "Testing ... ");
}

void Screen::ShowUseLastSetpointQuestion(double setpoint) {
  _tft.fillScreen(ILI9341_WHITE);
  _tft.setTextSize(2);
  Print(20, 50, "Last Set at ");
  _tft.print(setpoint, 0);
  Print(20, 90, "Use This ?");
  Print(35, 220, "Yes");
  Print(135, 220, "No");
}

void Screen::UpdateSetpoint(double oldSetpoint, double newSetpoint) {
  UpdateStandardDouble(setpointLocationXY[0], setpointLocationXY[1], oldSetpoint, newSetpoint, 0);
}

void Screen::UpdateTemperature(double oldTemperature, double newTemperature) {
  UpdateStandardDouble(180, 95, oldTemperature, newTemperature, 1);
}

void Screen::UpdateStandardDouble(int minimumX, int y, double oldDouble, double newDouble, int decimalPlaces) {
  if (oldDouble == newDouble) { return; }
  PrintStandardDouble(minimumX, y, oldDouble, decimalPlaces, ILI9341_WHITE);
  PrintStandardDouble(minimumX, y, newDouble, decimalPlaces, ILI9341_BLACK);
}

void Screen::PrintStandardDouble(int minimumX, int y, double number, int decimalPlaces, int color) {
  if (number < 10) {
    Print(minimumX + 40, y, number, decimalPlaces, color);
  } else if (number < 100) {
    Print(minimumX + 20, y, number, decimalPlaces, color);
  } else {
    Print(minimumX, y, number, decimalPlaces, color);
  }
}

void Screen::UpdateOutput(double newOutput) {
  if (newOutput == 0) {
    FillOutputBars(false, false, false, false, false);
  }
  else if (newOutput < 20) {
    FillOutputBars(true, false, false, false, false);
  }
  else if (newOutput < 40) {
    FillOutputBars(true, true, false, false, false);
    }
  else if (newOutput < 60) {
    FillOutputBars(true, true, true, false, false);
    }
  else if (newOutput < 80) {
    FillOutputBars(true, true, true, true, false);
    }
  else if (newOutput <= 100) {
    FillOutputBars(true, true, true, true, true);
    }
}

void Screen::FillOutputBars(bool barOne, bool barTwo, bool barThree, bool barFour, bool barFive) {
  if(barOne) { _tft.fillRect(185, 145, 13, 6, ILI9341_BLACK); }
  if(!barOne) { _tft.fillRect(185, 145, 13, 6, ILI9341_WHITE); }
  if(barTwo) { _tft.fillRect(212, 137, 13, 14, ILI9341_BLACK); }
  if(!barTwo) { _tft.fillRect(212, 137, 13, 14, ILI9341_WHITE); }
  if(barThree) { _tft.fillRect(239, 129, 13, 22, ILI9341_BLACK); }
  if(!barThree) { _tft.fillRect(239, 129, 13, 22, ILI9341_WHITE); }
  if(barFour) { _tft.fillRect(266, 121, 13, 30, ILI9341_BLACK); }
  if(!barFour) { _tft.fillRect(266, 121, 13, 30, ILI9341_WHITE); }
  if(barFive) { _tft.fillRect(293, 113, 13, 38, ILI9341_BLACK); }
  if(!barFive) { _tft.fillRect(293, 113, 13, 38, ILI9341_WHITE); }
}

void Screen::Pause() {
  DrawUpArrow(ILI9341_WHITE);
  DrawDownArrow(ILI9341_WHITE);
  Print(210, 220, "Pause", ILI9341_WHITE);
  Print(45, 200, "Press Any Key");
  Print(70, 235, "To Resume");
}

void Screen::Resume() {
  Print(45, 200, "Press Any Key", ILI9341_WHITE);
  Print(70, 235, "To Resume", ILI9341_WHITE);
  Print(210, 220, "Pause");
  DrawUpArrow(ILI9341_RED);
  DrawDownArrow(ILI9341_BLUE);
}

void Screen::ShowArcLogo() {
  _tft.setTextSize(2);
  _tft.setRotation(1);
  _tft.fillScreen(ILI9341_WHITE);
  _tft.drawBitmap(50, 0, arcLogo, 256, 256, 0x001F);
}

void Screen::ShowSoftwareVersion() {
  _tft.fillScreen(ARC_GREEN);
  Print(120, 40, "ARC", ARC_BLUE);
  Print(55, 75, "Temperature", ARC_BLUE);
  Print(85, 110, "Controller", ARC_BLUE);
  Print(50, 170, "Software", ARC_BLUE);
  Print(200, 170, Ver, ARC_BLUE);
  Print(55, 210, Ver_Date, ARC_BLUE);
}

// test helpers ///////////////////////////////////////////////////////////////////////////////////////////////

unsigned long Screen::testFillScreen() {
  unsigned long start = micros();
  _tft.fillScreen(ILI9341_BLACK);
  yield();
  _tft.fillScreen(ILI9341_RED);
  yield();
  _tft.fillScreen(ILI9341_GREEN);
  yield();
  _tft.fillScreen(ILI9341_BLUE);
  yield();
  _tft.fillScreen(ILI9341_BLACK);
  yield();
  return micros() - start;
}

unsigned long Screen::testText() {
  _tft.fillScreen(ILI9341_BLACK);
  unsigned long start = micros();
  _tft.setCursor(0, 0);
  _tft.setTextColor(ILI9341_WHITE);
  _tft.setTextSize(1);
  _tft.println("Hello World!");
  _tft.setTextColor(ILI9341_YELLOW);
  _tft.setTextSize(2);
  _tft.println(1234.56);
  _tft.setTextColor(ILI9341_RED);
_tft.setTextSize(3);
  _tft.println(0xDEADBEEF, HEX);
  _tft.println();
  _tft.setTextColor(ILI9341_GREEN);
  _tft.setTextSize(5);
  _tft.println("Groop");
  _tft.setTextSize(2);
  _tft.println("I implore thee,");
  _tft.setTextSize(1);
  _tft.println("my foonting turlingdromes.");
  _tft.println("And hooptiously drangle me");
  _tft.println("with crinkly bindlewurdles,");
  _tft.println("Or I will rend thee");
  _tft.println("in the gobberwarts");
  _tft.println("with my blurglecruncheon,");
  _tft.println("see if I don't!");
  return micros() - start;
}

unsigned long Screen::testLines(uint16_t color) {
  unsigned long start, t;
  int           x1, y1, x2, y2,
                w = _tft.width(),
                h = _tft.height();

  _tft.fillScreen(ILI9341_BLACK);
  yield();
  
  x1 = y1 = 0;
  y2    = h - 1;
  start = micros();
  for(x2=0; x2<w; x2+=6) _tft.drawLine(x1, y1, x2, y2, color);
  x2    = w - 1;
  for(y2=0; y2<h; y2+=6) _tft.drawLine(x1, y1, x2, y2, color);
  t     = micros() - start; // fillScreen doesn't count against timing

  yield();
  _tft.fillScreen(ILI9341_BLACK);
  yield();

  x1    = w - 1;
  y1    = 0;
  y2    = h - 1;
  start = micros();
  for(x2=0; x2<w; x2+=6) _tft.drawLine(x1, y1, x2, y2, color);
  x2    = 0;
  for(y2=0; y2<h; y2+=6) _tft.drawLine(x1, y1, x2, y2, color);
  t    += micros() - start;

  yield();
  _tft.fillScreen(ILI9341_BLACK);
  yield();

  x1    = 0;
  y1    = h - 1;
  y2    = 0;
  start = micros();
  for(x2=0; x2<w; x2+=6) _tft.drawLine(x1, y1, x2, y2, color);
  x2    = w - 1;
  for(y2=0; y2<h; y2+=6) _tft.drawLine(x1, y1, x2, y2, color);
  t    += micros() - start;

  yield();
  _tft.fillScreen(ILI9341_BLACK);
  yield();

  x1    = w - 1;
  y1    = h - 1;
  y2    = 0;
  start = micros();
  for(x2=0; x2<w; x2+=6) _tft.drawLine(x1, y1, x2, y2, color);
  x2    = 0;
  for(y2=0; y2<h; y2+=6) _tft.drawLine(x1, y1, x2, y2, color);

  yield();
  return micros() - start;
}

unsigned long Screen::testFastLines(uint16_t color1, uint16_t color2) {
  unsigned long start;
  int           x, y, w = _tft.width(), h = _tft.height();

  _tft.fillScreen(ILI9341_BLACK);
  start = micros();
  for(y=0; y<h; y+=5) _tft.drawFastHLine(0, y, w, color1);
  for(x=0; x<w; x+=5) _tft.drawFastVLine(x, 0, h, color2);

  return micros() - start;
}

unsigned long Screen::testRects(uint16_t color) {
  unsigned long start;
  int           n, i, i2,
                cx = _tft.width()  / 2,
                cy = _tft.height() / 2;

  _tft.fillScreen(ILI9341_BLACK);
  n     = min(_tft.width(), _tft.height());
  start = micros();
  for(i=2; i<n; i+=6) {
    i2 = i / 2;
    _tft.drawRect(cx-i2, cy-i2, i, i, color);
  }

  return micros() - start;
}

unsigned long Screen::testFilledRects(uint16_t color1, uint16_t color2) {
  unsigned long start, t = 0;
  int           n, i, i2,
                cx = _tft.width()  / 2 - 1,
                cy = _tft.height() / 2 - 1;

  _tft.fillScreen(ILI9341_BLACK);
  n = min(_tft.width(), _tft.height());
  for(i=n; i>0; i-=6) {
    i2    = i / 2;
    start = micros();
    _tft.fillRect(cx-i2, cy-i2, i, i, color1);
    t    += micros() - start;
    // Outlines are not included in timing results
    _tft.drawRect(cx-i2, cy-i2, i, i, color2);
    yield();
  }

  return t;
}

unsigned long Screen::testFilledCircles(uint8_t radius, uint16_t color) {
  unsigned long start;
  int x, y, w = _tft.width(), h = _tft.height(), r2 = radius * 2;

  _tft.fillScreen(ILI9341_BLACK);
  start = micros();
  for(x=radius; x<w; x+=r2) {
    for(y=radius; y<h; y+=r2) {
      _tft.fillCircle(x, y, radius, color);
    }
  }

  return micros() - start;
}

unsigned long Screen::testCircles(uint8_t radius, uint16_t color) {
  unsigned long start;
  int           x, y, r2 = radius * 2,
                w = _tft.width()  + radius,
                h = _tft.height() + radius;

  // Screen is not cleared for this one -- this is
  // intentional and does not affect the reported time.
  start = micros();
  for(x=0; x<w; x+=r2) {
    for(y=0; y<h; y+=r2) {
      _tft.drawCircle(x, y, radius, color);
    }
  }

  return micros() - start;
}

unsigned long Screen::testTriangles() {
  unsigned long start;
  int           n, i, cx = _tft.width()  / 2 - 1,
                      cy = _tft.height() / 2 - 1;

  _tft.fillScreen(ILI9341_BLACK);
  n     = min(cx, cy);
  start = micros();
  for(i=0; i<n; i+=5) {
    _tft.drawTriangle(
      cx    , cy - i, // peak
      cx - i, cy + i, // bottom left
      cx + i, cy + i, // bottom right
      _tft.color565(i, i, i));
  }

  return micros() - start;
}

unsigned long Screen::testFilledTriangles() {
  unsigned long start, t = 0;
  int           i, cx = _tft.width()  / 2 - 1,
                   cy = _tft.height() / 2 - 1;

  _tft.fillScreen(ILI9341_BLACK);
  start = micros();
  for(i=min(cx,cy); i>10; i-=5) {
    start = micros();
    _tft.fillTriangle(cx, cy - i, cx - i, cy + i, cx + i, cy + i,
      _tft.color565(0, i*10, i*10));
    t += micros() - start;
    _tft.drawTriangle(cx, cy - i, cx - i, cy + i, cx + i, cy + i,
      _tft.color565(i*10, i*10, 0));
    yield();
  }

  return t;
}

unsigned long Screen::testRoundRects() {
  unsigned long start;
  int           w, i, i2,
                cx = _tft.width()  / 2 - 1,
                cy = _tft.height() / 2 - 1;

  _tft.fillScreen(ILI9341_BLACK);
  w     = min(_tft.width(), _tft.height());
  start = micros();
  for(i=0; i<w; i+=6) {
    i2 = i / 2;
    _tft.drawRoundRect(cx-i2, cy-i2, i, i, i/8, _tft.color565(i, 0, 0));
  }

  return micros() - start;
}

unsigned long Screen::testFilledRoundRects() {
  unsigned long start;
  int           i, i2,
                cx = _tft.width()  / 2 - 1,
                cy = _tft.height() / 2 - 1;

  _tft.fillScreen(ILI9341_BLACK);
  start = micros();
  for(i=min(_tft.width(), _tft.height()); i>20; i-=6) {
    i2 = i / 2;
    _tft.fillRoundRect(cx-i2, cy-i2, i, i, i/8, _tft.color565(0, i, 0));
    yield();
  }

  return micros() - start;
}
